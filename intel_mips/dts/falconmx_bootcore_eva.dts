/dts-v1/;

/*****************************************************************
** Include a chip configuration file                             
*****************************************************************/
/include/ "falconmx_bootcore.dtsi"

/ {
      model = "FalconMX Evaluation Board BOOTCORE (MIPS 4Kec)";

};
